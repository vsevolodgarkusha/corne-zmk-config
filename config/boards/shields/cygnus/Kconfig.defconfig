## config/boards/shields/cygnus/Kconfig.defconfig
```kconfig
if SHIELD_CYGNUS_LEFT

config ZMK_KEYBOARD_NAME
    default "Cygnus psyg"

config ZMK_SPLIT_ROLE_CENTRAL
    default y

config ZMK_SPLIT
    default y

endif
```
